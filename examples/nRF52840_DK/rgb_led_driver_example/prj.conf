## CMakeLists.txt
```
# SPDX-License-Identifier: Apache-2.0

cmake_minimum_required(VERSION 3.20.0)

find_package(Zephyr REQUIRED HINTS $ENV{ZEPHYR_BASE})
project(hello_world)

target_sources(app PRIVATE src/main.c ../../../rgb_led_driver/rgb_led_driver.c src/shell_commands.c)
include_directories(../../../rgb_led_driver)
```

## prj.conf
```kconfig
# nothing here
CONFIG_PWM=y

#
# C Library
#
# CONFIG_MINIMAL_LIBC is not set
CONFIG_NEWLIB_LIBC=y
# CONFIG_EXTERNAL_LIBC is not set
# CONFIG_HAS_NEWLIB_LIBC_NANO=y
# CONFIG_NEWLIB_LIBC_NANO=y
# CONFIG_NEWLIB_LIBC_MIN_REQUIRED_HEAP_SIZE=2048
# CONFIG_NEWLIB_LIBC_FLOAT_SCANF is not set
CONFIG_STDOUT_CONSOLE=y
# end of C Library

CONFIG_SHELL=y
CONFIG_SHELL_BACKENDS=y
CONFIG_SHELL_BACKEND_SERIAL=y
CONFIG_SHELL_BACKEND_SERIAL_INIT_PRIORITY=0
CONFIG_SHELL_PROMPT_UART="uart:~$ "
CONFIG_UART_SHELL_ON_DEV_NAME="UART_0"
CONFIG_SHELL_BACKEND_SERIAL_INTERRUPT_DRIVEN=y
CONFIG_SHELL_BACKEND_SERIAL_TX_RING_BUFFER_SIZE=8
CONFIG_SHELL_BACKEND_SERIAL_RX_RING_BUFFER_SIZE=64
CONFIG_SHELL_BACKEND_SERIAL_LOG_MESSAGE_QUEUE_TIMEOUT=100
CONFIG_SHELL_BACKEND_SERIAL_LOG_MESSAGE_QUEUE_SIZE=10
CONFIG_SHELL_BACKEND_SERIAL_LOG_LEVEL_DEFAULT=y
# CONFIG_SHELL_BACKEND_SERIAL_LOG_LEVEL_DBG is not set
# CONFIG_SHELL_BACKEND_SERIAL_LOG_LEVEL_INF is not set
# CONFIG_SHELL_BACKEND_SERIAL_LOG_LEVEL_WRN is not set
# CONFIG_SHELL_BACKEND_SERIAL_LOG_LEVEL_ERR is not set
# CONFIG_SHELL_BACKEND_SERIAL_LOG_LEVEL_NONE is not set
# CONFIG_SHELL_BACKEND_SERIAL_LOG_LEVEL=5
# CONFIG_SHELL_BACKEND_RTT is not set
# CONFIG_SHELL_BACKEND_DUMMY is not set
# CONFIG_SHELL_MINIMAL is not set
CONFIG_SHELL_STACK_SIZE=2048
CONFIG_SHELL_BACKSPACE_MODE_DELETE=y
CONFIG_SHELL_CMD_BUFF_SIZE=256
CONFIG_SHELL_PRINTF_BUFF_SIZE=30
CONFIG_SHELL_DEFAULT_TERMINAL_WIDTH=80
CONFIG_SHELL_DEFAULT_TERMINAL_HEIGHT=24
CONFIG_SHELL_ARGC_MAX=12
CONFIG_SHELL_TAB=y
CONFIG_SHELL_TAB_AUTOCOMPLETION=y
CONFIG_SHELL_WILDCARD=y
CONFIG_SHELL_ECHO_STATUS=y
# CONFIG_SHELL_START_OBSCURED is not set
CONFIG_SHELL_VT100_COMMANDS=y
CONFIG_SHELL_VT100_COLORS=y
# CONFIG_SHELL_GETOPT is not set
CONFIG_SHELL_METAKEYS=y
CONFIG_SHELL_HELP=y
CONFIG_SHELL_HELP_OPT_PARSE=y
CONFIG_SHELL_HELP_ON_WRONG_ARGUMENT_COUNT=y
CONFIG_SHELL_HISTORY=y
CONFIG_SHELL_HISTORY_BUFFER=512
CONFIG_SHELL_STATS=y
CONFIG_SHELL_CMDS=y
CONFIG_SHELL_CMDS_RESIZE=y
# CONFIG_SHELL_CMDS_SELECT is not set
CONFIG_SHELL_CMD_ROOT=""
```

## nrf52840dk_nrf52840.overlay
```dts
&pwm0 {
    status = "okay";
    ch0-pin = <13>;
    ch1-pin = <14>;
    ch2-pin = <15>;
    ch3-pin = <16>;
};
```

## src/main.c
```c
/*==========================================================================================================*\
 * MIT License
 *
 * Copyright (c) 2022 Pawel Kusinski
 *
 * Permission is hereby granted, free of charge, to any person obtaining a copy
 * of this software and associated documentation files (the "Software"), to deal
 * in the Software without restriction, including without limitation the rights
 * to use, copy, modify, merge, publish, distribute, sublicense, and/or sell
 * copies of the Software, and to permit persons to whom the Software is
 * furnished to do so, subject to the following conditions:
 *
 * The above copyright notice and this permission notice shall be included in all
 * copies or substantial portions of the Software.
 *
 * THE SOFTWARE IS PROVIDED "AS IS", WITHOUT WARRANTY OF ANY KIND, EXPRESS OR
 * IMPLIED, INCLUDING BUT NOT LIMITED TO THE WARRANTIES OF MERCHANTABILITY,
 * FITNESS FOR A PARTICULAR PURPOSE AND NONINFRINGEMENT. IN NO EVENT SHALL THE
 * AUTHORS OR COPYRIGHT HOLDERS BE LIABLE FOR ANY CLAIM, DAMAGES OR OTHER
 * LIABILITY, WHETHER IN AN ACTION OF CONTRACT, TORT OR OTHERWISE, ARISING FROM,
 * OUT OF OR IN CONNECTION WITH THE SOFTWARE OR THE USE OR OTHER DEALINGS IN THE
 * SOFTWARE.
\*==========================================================================================================*/

#include <stdint.h>
#include <stdbool.h>

#include <zephyr.h>
#include <sys/printk.h>
#include <zephyr.h>
#include <device.h>
#include <drivers/gpio.h>
#include <sys/printk.h>
#include <drivers/pwm.h>
#include <kernel.h>

#include "rgb_led_driver.h"

extern bool run_example_sequence;
extern RgbLed my_led;
RgbLed my_led = NULL;
bool run_example_sequence = true;
static const struct device *pwm_dev;

static bool initializePwm0(void);
static void setDutyCycleLedRed(uint8_t duty_cycle);
static void setDutyCycleLedGreen(uint8_t duty_cycle);
static void setDutyCycleLedBlue(uint8_t duty_cycle);
static void runExampleSequence(RgbLed led);

void main(void) {
    if (!initializePwm0()) {
        printk("Failed to initialized PWM_0.\n");
        goto fail;
    }

    setDutyCycleLedRed(100);
    setDutyCycleLedGreen(100);
    setDutyCycleLedBlue(100);

    my_led = RgbLedDrv_create(setDutyCycleLedRed, setDutyCycleLedGreen, setDutyCycleLedBlue,
                              RGB_LED_CFG_COMM_ANODE, RGB_LED_COLOR_CUSTOM, 255, 0, 0, true);

    if (RGB_LED_DRV_INVALID_OBJECT == my_led) {
        printk("Failed to create LED1.\n");
        goto fail;
    }

    while (1) {
        if (run_example_sequence) {
            runExampleSequence(my_led);
        } else {
            k_sleep(K_MSEC(100));
        }
        
    }

fail:
    while(1) {
        k_sleep(K_MSEC(100));
    }

    RgbLedDrv_destroy(my_led);
}

static bool initializePwm0(void) {
    pwm_dev = device_get_binding("PWM_0");

    if (!pwm_dev) {
        return false;
    }

    return true;
}

static void setDutyCycleLedRed(uint8_t duty_cycle) {
    if (duty_cycle > 100) {
        printk("%s: Invalid duty cycle %u.\n", __func__, duty_cycle);
        return;
    }

    if (pwm_pin_set_usec(pwm_dev, 14, 100, duty_cycle, 0)) {
        printk("%s: pwm_pin_set_usec failed.\n", __func__);
    }
}

static void setDutyCycleLedGreen(uint8_t duty_cycle) {
    if (duty_cycle > 100) {
        printk("%s: Invalid duty cycle %u.\n", __func__, duty_cycle);
        return;
    }

    if (pwm_pin_set_usec(pwm_dev, 15, 100, duty_cycle, 0)) {
        printk("%s: pwm_pin_set_usec failed.\n", __func__);
    }
}

static void setDutyCycleLedBlue(uint8_t duty_cycle) {
    if (duty_cycle > 100) {
        printk("%s: Invalid duty cycle %u.\n", __func__, duty_cycle);
        return;
    }

    if (pwm_pin_set_usec(pwm_dev, 16, 100, duty_cycle, 0)) {
        printk("%s: pwm_pin_set_usec failed.\n", __func__);
    }
}

static void runExampleSequence(RgbLed led) {
    struct rgb_t {
        uint8_t r;
        uint8_t g;
        uint8_t b;
    };

    static const struct rgb_t rainbow[12] = {
        {.r = 255, .g = 0,   .b = 0},
        {.r = 255, .g = 127, .b = 0},
        {.r = 255, .g = 255, .b = 0},
        {.r = 127, .g = 255, .b = 0},
        {.r = 0,   .g = 255, .b = 0},
        {.r = 0,   .g = 255, .b = 127},
        {.r = 0,   .g = 255, .b = 255},
        {.r = 0,   .g = 127, .b = 255},
        {.r = 0,   .g = 0,   .b = 255},
        {.r = 127, .g = 0,   .b = 255},
        {.r = 255, .g = 0,   .b = 255},
        {.r = 255, .g = 0,   .b = 127},
    };

    unsigned i;

    for (i = 0; i < 12; ++i) {
        RgbLedDrv_setCustomColor(led, rainbow[i].r, rainbow[i].g, rainbow[i].b);
        k_sleep(K_MSEC(100));
    }
}
```

## src/shell_commands.c
```c
/*==========================================================================================================*\
 * MIT License
 *
 * Copyright (c) 2022 Pawel Kusinski
 *
 * Permission is hereby granted, free of charge, to any person obtaining a copy
 * of this software and associated documentation files (the "Software"), to deal
 * in the Software without restriction, including without limitation the rights
 * to use, copy, modify, merge, publish, distribute, sublicense, and/or sell
 * copies of the Software, and to permit persons to whom the Software is
 * furnished to do so, subject to the following conditions:
 *
 * The above copyright notice and this permission notice shall be included in all
 * copies or substantial portions of the Software.
 *
 * THE SOFTWARE IS PROVIDED "AS IS", WITHOUT WARRANTY OF ANY KIND, EXPRESS OR
 * IMPLIED, INCLUDING BUT NOT LIMITED TO THE WARRANTIES OF MERCHANTABILITY,
 * FITNESS FOR A PARTICULAR PURPOSE AND NONINFRINGEMENT. IN NO EVENT SHALL THE
 * AUTHORS OR COPYRIGHT HOLDERS BE LIABLE FOR ANY CLAIM, DAMAGES OR OTHER
 * LIABILITY, WHETHER IN AN ACTION OF CONTRACT, TORT OR OTHERWISE, ARISING FROM,
 * OUT OF OR IN CONNECTION WITH THE SOFTWARE OR THE USE OR OTHER DEALINGS IN THE
 * SOFTWARE.
\*==========================================================================================================*/

#include "shell_commands.h"
#include <stdbool.h>
#include <stdint.h>
#include <stdlib.h>
#include <string.h>
#include "rgb_led_driver.h"

extern bool run_example_sequence;
extern RgbLed my_led;

int ShellCmd_runExampleRgbLedSequence(const struct shell *shell, size_t argc, char **argv) {
    run_example_sequence = true;
    return 0;
}

int ShellCmd_pauseExampleRgbLedSequence(const struct shell *shell, size_t argc, char **argv) {
    run_example_sequence = false;
    return 0;
}

int ShellCmd_setCustomColor(const struct shell *shell, size_t argc, char **argv) {
    if (argc != 4) {
        shell_print(shell, "Invalid number of arguments.");
        return 0;
    }

    uint8_t red = atoi(argv[1]);
    uint8_t green = atoi(argv[2]);
    uint8_t blue = atoi(argv[3]);
    shell_print(shell, "Setting RGB: %u %u %u.", red, green, blue);
    RgbLedDrv_setCustomColor(my_led, red, green, blue);
    return 0;
}

int ShellCmd_setPredefinedColor(const struct shell *shell, size_t argc, char **argv) {
    const char* colors[7] = {"red", "green", "blue", "yellow", "cyan", "magenta", "white"};

    if (argc != 2) {
        goto invalid_command;
    }

    int color_idx;

    for (color_idx = 0; color_idx < 7; ++color_idx) {
        if (0 == strcmp(colors[color_idx], argv[1])) {
            /* Second parameter should be RgbLedColor enum type, but using index is good enough for this demo code. */
            RgbLedDrv_setPredefinedColor(my_led, color_idx);
            return 0;
        }
    }

invalid_command:
    shell_print(shell, "Invalid usage. This command requires one parameter and it should one of the following options: "
                "%s, %s, %s, %s, %s, %s, %s.", colors[0], colors[1], colors[2], colors[3], colors[4], colors[5], colors[6]);

    return 0;
}

int ShellCmd_turnOn(const struct shell *shell, size_t argc, char **argv) {
    RgbLedDrv_turnOn(my_led);
    return 0;
}

int ShellCmd_turnOff(const struct shell *shell, size_t argc, char **argv) {
    RgbLedDrv_turnOff(my_led);
    return 0;
}
```

## src/shell_commands.h
```c
/*==========================================================================================================*\
 * MIT License
 *
 * Copyright (c) 2022 Pawel Kusinski
 *
 * Permission is hereby granted, free of charge, to any person obtaining a copy
 * of this software and associated documentation files (the "Software"), to deal
 * in the Software without restriction, including without limitation the rights
 * to use, copy, modify, merge, publish, distribute, sublicense, and/or sell
 * copies of the Software, and to permit persons to whom the Software is
 * furnished to do so, subject to the following conditions:
 *
 * The above copyright notice and this permission notice shall be included in all
 * copies or substantial portions of the Software.
 *
 * THE SOFTWARE IS PROVIDED "AS IS", WITHOUT WARRANTY OF ANY KIND, EXPRESS OR
 * IMPLIED, INCLUDING BUT NOT LIMITED TO THE WARRANTIES OF MERCHANTABILITY,
 * FITNESS FOR A PARTICULAR PURPOSE AND NONINFRINGEMENT. IN NO EVENT SHALL THE
 * AUTHORS OR COPYRIGHT HOLDERS BE LIABLE FOR ANY CLAIM, DAMAGES OR OTHER
 * LIABILITY, WHETHER IN AN ACTION OF CONTRACT, TORT OR OTHERWISE, ARISING FROM,
 * OUT OF OR IN CONNECTION WITH THE SOFTWARE OR THE USE OR OTHER DEALINGS IN THE
 * SOFTWARE.
\*==========================================================================================================*/

#ifndef SHELL_COMMANDS_H
#define SHELL_COMMANDS_H

/* include directives --------------------------------------------------------------------------------------*/

#include <zephyr.h>
#include <sys/printk.h>
#include <shell/shell.h>

/* exported defines for constants --------------------------------------------------------------------------*/

/* exported typedef declarations ---------------------------------------------------------------------------*/

/* exported object declarations ----------------------------------------------------------------------------*/

/* exported function prototypes ----------------------------------------------------------------------------*/

int ShellCmd_runExampleRgbLedSequence(const struct shell *shell, size_t argc, char **argv);
int ShellCmd_pauseExampleRgbLedSequence(const struct shell *shell, size_t argc, char **argv);
int ShellCmd_setCustomColor(const struct shell *shell, size_t argc, char **argv);
int ShellCmd_setPredefinedColor(const struct shell *shell, size_t argc, char **argv);
int ShellCmd_turnOn(const struct shell *shell, size_t argc, char **argv);
int ShellCmd_turnOff(const struct shell *shell, size_t argc, char **argv);

SHELL_STATIC_SUBCMD_SET_CREATE(sub_rgb_led,
        SHELL_CMD(run_example_sequence, NULL, "Run example RGB LED sequence.", ShellCmd_runExampleRgbLedSequence),
        SHELL_CMD(pause_example_sequence, NULL, "Pause example RGB LED sequence.", ShellCmd_pauseExampleRgbLedSequence),
        SHELL_CMD(set_custom_color, NULL, "Set custom color by passing RGB components values.", ShellCmd_setCustomColor),
        SHELL_CMD(set_predefined_color, NULL, "Set one of predefined colors: RED, GREEN, BLUE, YELLOW, CYAN, MAGENTA, WHITE.", ShellCmd_setPredefinedColor),
        SHELL_CMD(on, NULL, "Turn the RGB LED on.", ShellCmd_turnOn),
        SHELL_CMD(off, NULL, "Turn the RGB LED off.", ShellCmd_turnOff),
        SHELL_SUBCMD_SET_END
);

SHELL_CMD_REGISTER(rgb_led, &sub_rgb_led, "RGB LED commands", NULL);

/* exported macros and inline functions --------------------------------------------------------------------*/

#endif
```
